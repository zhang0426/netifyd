## deploy/buildroot/Config.in
```kconfig
config BR2_PACKAGE_NETIFYD
    bool "netifyd"
    select BR2_PACKAGE_LIBCURL
    select BR2_PACKAGE_LIBUNWIND
    depends on BR2_INSTALL_LIBSTDCPP
    depends on BR2_TOOLCHAIN_HAS_THREADS_NPTL
    help
        Build the Netify DPI Agent.

        https://www.netify.ai/
```
